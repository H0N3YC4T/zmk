
#include <dt-bindings/zmk/kscan_mock.h>

#include "shared.dtsi"

&kscan {
    exit-after;
    events =
    <ZMK_MOCK_RELEASE(0,0,5000)
    ZMK_MOCK_PRESS(0,0,200)
    ZMK_MOCK_RELEASE(0,0,4000)>;
};
