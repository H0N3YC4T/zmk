
#include <dt-bindings/zmk/kscan_mock.h>

#include "shared.dtsi"

&kscan {
    exit-after;
    events =
    <ZMK_MOCK_RELEASE(0,0,5300)
    ZMK_MOCK_PRESS(0,1,200)
    ZMK_MOCK_RELEASE(0,1,3400)>;
};
