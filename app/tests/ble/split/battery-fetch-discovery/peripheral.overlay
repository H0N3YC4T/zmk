
#include <dt-bindings/zmk/kscan_mock.h>

#include "shared.dtsi"

&kscan {
    events =
    <ZMK_MOCK_RELEASE(0,0,5000)
    ZMK_MOCK_PRESS(0,0,5000)
    ZMK_MOCK_RELEASE(0,0,200)
    ZMK_MOCK_PRESS(0,1,10)
    ZMK_MOCK_RELEASE(0,1,2000)>;
};

&mock_encoder {
    status = "okay";

    event-startup-delay = <16000>;
    event-period = <2000>;
    events = <18 (-18)>;
};
