
#include <dt-bindings/zmk/kscan_mock.h>

#include "shared.dtsi"

/* 40 B taps, 300ms apart, from 12s */
&kscan {
    events =
    <ZMK_MOCK_RELEASE(0,0,6000)
    ZMK_MOCK_PRESS(0,1,150)
    ZMK_MOCK_RELEASE(0,1,150)
    ZMK_MOCK_PRESS(0,1,150)
    ZMK_MOCK_RELEASE(0,1,150)
    ZMK_MOCK_PRESS(0,1,150)
    ZMK_MOCK_RELEASE(0,1,150)
    ZMK_MOCK_PRESS(0,1,150)
    ZMK_MOCK_RELEASE(0,1,150)
    ZMK_MOCK_PRESS(0,1,150)
    ZMK_MOCK_RELEASE(0,1,150)
    ZMK_MOCK_PRESS(0,1,150)
    ZMK_MOCK_RELEASE(0,1,150)
    ZMK_MOCK_PRESS(0,1,150)
    ZMK_MOCK_RELEASE(0,1,150)
    ZMK_MOCK_PRESS(0,1,150)
    ZMK_MOCK_RELEASE(0,1,150)
    ZMK_MOCK_PRESS(0,1,150)
    ZMK_MOCK_RELEASE(0,1,150)
    ZMK_MOCK_PRESS(0,1,150)
    ZMK_MOCK_RELEASE(0,1,150)
    ZMK_MOCK_PRESS(0,1,150)
    ZMK_MOCK_RELEASE(0,1,150)
    ZMK_MOCK_PRESS(0,1,150)
    ZMK_MOCK_RELEASE(0,1,150)
    ZMK_MOCK_PRESS(0,1,150)
    ZMK_MOCK_RELEASE(0,1,150)
    ZMK_MOCK_PRESS(0,1,150)
    ZMK_MOCK_RELEASE(0,1,150)
    ZMK_MOCK_PRESS(0,1,150)
    ZMK_MOCK_RELEASE(0,1,150)
    ZMK_MOCK_PRESS(0,1,150)
    ZMK_MOCK_RELEASE(0,1,150)
    ZMK_MOCK_PRESS(0,1,150)
    ZMK_MOCK_RELEASE(0,1,150)
    ZMK_MOCK_PRESS(0,1,150)
    ZMK_MOCK_RELEASE(0,1,150)
    ZMK_MOCK_PRESS(0,1,150)
    ZMK_MOCK_RELEASE(0,1,150)
    ZMK_MOCK_PRESS(0,1,150)
    ZMK_MOCK_RELEASE(0,1,150)
    ZMK_MOCK_PRESS(0,1,150)
    ZMK_MOCK_RELEASE(0,1,150)
    ZMK_MOCK_PRESS(0,1,150)
    ZMK_MOCK_RELEASE(0,1,150)
    ZMK_MOCK_PRESS(0,1,150)
    ZMK_MOCK_RELEASE(0,1,150)
    ZMK_MOCK_PRESS(0,1,150)
    ZMK_MOCK_RELEASE(0,1,150)
    ZMK_MOCK_PRESS(0,1,150)
    ZMK_MOCK_RELEASE(0,1,150)
    ZMK_MOCK_PRESS(0,1,150)
    ZMK_MOCK_RELEASE(0,1,150)
    ZMK_MOCK_PRESS(0,1,150)
    ZMK_MOCK_RELEASE(0,1,150)
    ZMK_MOCK_PRESS(0,1,150)
    ZMK_MOCK_RELEASE(0,1,150)
    ZMK_MOCK_PRESS(0,1,150)
    ZMK_MOCK_RELEASE(0,1,150)
    ZMK_MOCK_PRESS(0,1,150)
    ZMK_MOCK_RELEASE(0,1,150)
    ZMK_MOCK_PRESS(0,1,150)
    ZMK_MOCK_RELEASE(0,1,150)
    ZMK_MOCK_PRESS(0,1,150)
    ZMK_MOCK_RELEASE(0,1,150)
    ZMK_MOCK_PRESS(0,1,150)
    ZMK_MOCK_RELEASE(0,1,150)
    ZMK_MOCK_PRESS(0,1,150)
    ZMK_MOCK_RELEASE(0,1,150)
    ZMK_MOCK_PRESS(0,1,150)
    ZMK_MOCK_RELEASE(0,1,150)
    ZMK_MOCK_PRESS(0,1,150)
    ZMK_MOCK_RELEASE(0,1,150)
    ZMK_MOCK_PRESS(0,1,150)
    ZMK_MOCK_RELEASE(0,1,150)
    ZMK_MOCK_PRESS(0,1,150)
    ZMK_MOCK_RELEASE(0,1,150)
    ZMK_MOCK_PRESS(0,1,150)
    ZMK_MOCK_RELEASE(0,1,150)
    ZMK_MOCK_PRESS(0,1,150)
    ZMK_MOCK_RELEASE(0,1,150)>;
};
